## config/boards/shields/totem/Kconfig.defconfig
```kconfig
# Copyright (c) 2022 The ZMK Contributors
# SPDX-License-Identifier: MIT

if SHIELD_TOTEM_LEFT

config ZMK_KEYBOARD_NAME
    default "TOTEM"
    
config ZMK_SPLIT_ROLE_CENTRAL
    default y

endif

if SHIELD_TOTEM_DONGLE

config ZMK_KEYBOARD_NAME
    default "MX TOTEM"

config ZMK_SPLIT_ROLE_CENTRAL
    default y

config ZMK_SPLIT_BLE_CENTRAL_PERIPHERALS
    default 3

# Three split peripherals plus ZMK's five Bluetooth host profiles.
config BT_MAX_CONN
    default 8

config BT_MAX_PAIRED
    default 8

endif

if SHIELD_TOTEM_DIAL

config ZMK_KEYBOARD_NAME
    default "MX Dial"

config ZMK_SPLIT_ROLE_CENTRAL
    default n

config I2C
    default y

config ZMK_POINTING
    default y

endif

if SHIELD_TOTEM_LEFT || SHIELD_TOTEM_RIGHT || SHIELD_TOTEM_DONGLE || SHIELD_TOTEM_DIAL

config ZMK_SPLIT
    default y

endif
```

## config/boards/shields/xiao_esp32_bridge/Kconfig.defconfig
```kconfig
# SPDX-License-Identifier: MIT

if SHIELD_XIAO_ESP32_BRIDGE

config SERIAL
    default y

endif
```

## config/boards/shields/xiao_esp32_bridge/Kconfig.shield
```kconfig
# SPDX-License-Identifier: MIT

config SHIELD_XIAO_ESP32_BRIDGE
    def_bool $(shields_list_contains,xiao_esp32_bridge)
```

## config/boards/shields/xiao_ssd1306/Kconfig.defconfig
```kconfig
# SPDX-License-Identifier: MIT

if SHIELD_XIAO_SSD1306

choice ZMK_DISPLAY_STATUS_SCREEN
    default ZMK_DISPLAY_STATUS_SCREEN_CUSTOM
endchoice

config ZMK_DISPLAY_STATUS_SCREEN_CUSTOM
    select LV_USE_LABEL
    select LV_FONT_UNSCII_8
    select LV_FONT_MONTSERRAT_32

config I2C
    default y

config SSD1306
    default y

config ZMK_DISPLAY
    default y

if LVGL

config LV_Z_VDB_SIZE
    default 64

config LV_DPI_DEF
    default 148

config LV_Z_BITS_PER_PIXEL
    default 1

choice LV_COLOR_DEPTH
    default LV_COLOR_DEPTH_1
endchoice

endif # LVGL

endif # SHIELD_XIAO_SSD1306
```

## config/boards/shields/xiao_ssd1306/Kconfig.shield
```kconfig
# SPDX-License-Identifier: MIT

config SHIELD_XIAO_SSD1306
    def_bool $(shields_list_contains,xiao_ssd1306)
```

## config/boards/shields/xiao_st7789_diag/Kconfig.defconfig
```kconfig
# SPDX-License-Identifier: MIT

if SHIELD_XIAO_ST7789_DIAG

config GPIO
    default y

endif # SHIELD_XIAO_ST7789_DIAG
```

## config/boards/shields/xiao_st7789_diag/Kconfig.shield
```kconfig
# SPDX-License-Identifier: MIT

config SHIELD_XIAO_ST7789_DIAG
    def_bool $(shields_list_contains,xiao_st7789_diag)
```

## config/boards/shields/xiao_st7789_merry/Kconfig.defconfig
```kconfig
# SPDX-License-Identifier: MIT

if SHIELD_XIAO_ST7789_MERRY

choice ZMK_DISPLAY_STATUS_SCREEN
    default ZMK_DISPLAY_STATUS_SCREEN_CUSTOM
endchoice

config ZMK_DISPLAY_STATUS_SCREEN_CUSTOM
    select LV_USE_LABEL
    select LV_USE_IMAGE
    select LV_USE_LINE
    select LV_FONT_MONTSERRAT_16
    select LV_FONT_MONTSERRAT_20
    select LV_FONT_MONTSERRAT_32

config ZMK_DISPLAY
    default y

config SPI
    default y

config ST7789V
    default y

config PWM
    default y

config LED
    default y

config MERRY_SCREEN_OFF_DELAY_MS
    int "Delay from pet mode to display off (milliseconds)"
    default 300000
    range 10000 3600000

choice ST7789V_PIXEL_FORMAT
    default ST7789V_RGB565
endchoice

if LVGL

config LV_Z_VDB_SIZE
    default 10

config LV_DPI_DEF
    default 261

config LV_Z_BITS_PER_PIXEL
    default 16

choice LV_COLOR_DEPTH
    default LV_COLOR_DEPTH_16
endchoice

config LV_COLOR_16_SWAP
    default y

endif # LVGL

endif # SHIELD_XIAO_ST7789_MERRY
```

## drivers/input/Kconfig
```kconfig
if INPUT

config INPUT_AS5600_SCROLL
    bool "AS5600 magnetic dial scroll input"
    default y
    depends on I2C
    depends on DT_HAS_AYAAN_AS5600_SCROLL_ENABLED
    help
      Poll an AS5600 absolute magnetic encoder and emit accelerated vertical
      wheel events through Zephyr's input subsystem.


config INPUT_AS5600_SCROLL_DIAGNOSTICS
    bool "Verbose AS5600 dial diagnostics"
    default n
    depends on INPUT_AS5600_SCROLL
    help
      Log a roughly 1 Hz raw-angle heartbeat plus one line per emitted wheel
      event. Intended only for temporary USB-logging bring-up images; leave
      this off in release firmware, where the poll rate would flood the log.
endif
```

## dts/bindings/input/ayaan,as5600-scroll.yaml
```yaml
description: AS5600 magnetic angle sensor exposed as an accelerated wheel input

compatible: "ayaan,as5600-scroll"

include: i2c-device.yaml

properties:
  poll-interval-ms:
    type: int
    default: 4
    description: Time between angle samples.

  startup-delay-ms:
    type: int
    default: 100
    description: Delay before the first sample, allowing the sensor to settle.

  counts-per-scroll:
    type: int
    default: 32
    description: Raw AS5600 counts that produce one wheel unit at low speed.

  acceleration-threshold:
    type: int
    default: 1800
    description: Raw counts per second at which acceleration starts.

  acceleration-multiplier:
    type: int
    default: 2
    description: Multiplier above acceleration-threshold.

  fast-threshold:
    type: int
    default: 7000
    description: Raw counts per second at which the fast multiplier starts.

  fast-multiplier:
    type: int
    default: 4
    description: Multiplier above fast-threshold.

  invert-scroll:
    type: boolean
    description: Reverse the generated vertical wheel direction.

  max-delta-counts:
    type: int
    default: 512
    description: |
      Largest plausible change in raw counts between two polls. Anything
      larger is treated as a sensor artefact, discarded, and the reference
      resynced, so one bad sample cannot be amplified into hundreds of wheel
      clicks. At the default 4 ms poll, 512 counts is over 30 rev/s, far
      beyond a hand-turned knob. Set to 0 to disable the check.

  deadband-counts:
    type: int
    default: 4
    description: |
      Movements smaller than this hold the reference angle still instead of
      following it, so low-level jitter cannot random-walk the accumulator.
      Slow genuine rotation still accumulates against the held reference and
      is not lost; it simply resolves in deadband-sized steps.
```
