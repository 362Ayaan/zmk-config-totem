#include <behaviors.dtsi>
#include <dt-bindings/zmk/keys.h>

/ {
    keymap {
        compatible = "zmk,keymap";

        default_layer {
            sensor-bindings = <&inc_dec_kp C_VOL_UP C_VOL_DN>;

            bindings = <
                &none
            >;
        };
    };
};
